// SPDX-License-Identifier: (GPL-2.0 OR MIT)
/* Copyright (c) 2020-2021 Microchip Technology Inc */

/dts-v1/;
/plugin/;

&{/chosen} {
	overlays {
		MINIMAL-CAPE-GATEWARE = "GATEWARE_GIT_VERSION";
	};
};

&gpio2 {
	gpio-line-names = "P8_3_USER_LED_0", "P8_4_USER_LED_1", "P8_5_USER_LED_2",
			  "P8_6_USER_LED_3", "P8_7_USER_LED_4", "P8_8_USER_LED_5",
			  "P8_9_USER_LED_6", "P8_10_USER_LED_7", "P8_11_USER_LED_8",
			  "P8_12_USER_LED_9", "P8_13_USER_LED_10", "P8_14_USER_LED_11",
			  "", "", "", "", "",
			  "", "", "",	"", "",
			  "", "", "", "", "",
			  "",
			  "M2_W_DISABLE1", "M2_W_DISABLE2",
			  "VIO_ENABLE", "SD_DET";
};

&mmuart4 {
	status = "okay";
	symlink = "bone/uart/4";
};
