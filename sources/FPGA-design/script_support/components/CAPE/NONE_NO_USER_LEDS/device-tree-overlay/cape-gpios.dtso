// SPDX-License-Identifier: (GPL-2.0 OR MIT)
/* Copyright (c) 2020-2021 Microchip Technology Inc */

/dts-v1/;
/plugin/;

&{/chosen} {
	overlays {
		MINIMAL-NO-LEDS-CAPE-GATEWARE = "GATEWARE_GIT_VERSION";
	};
};

&gpio2 {
	gpio-line-names = "", "", "",
			  "", "", "",
			  "", "", "",
			  "", "", "",
			  "", "", "", "", "",
			  "", "", "", "", "",
			  "", "", "", "", "",
			  "",
			  "", "", "VIO_ENABLE", "SD_DET";
};

&mmuart4 {
	status = "okay";
	symlink = "bone/uart/4";
};
